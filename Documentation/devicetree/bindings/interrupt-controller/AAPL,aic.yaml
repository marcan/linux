## Documentation/devicetree/bindings/interrupt-controller/AAPL,aic.yaml
```yaml
# SPDX-License-Identifier: (GPL-2.0 OR BSD-2-Clause)
%YAML 1.2
---
$id: http://devicetree.org/schemas/interrupt-controller/AAPL,aic.yaml#
$schema: http://devicetree.org/meta-schemas/core.yaml#

title: Apple Interrupt Controller

maintainers:
  - Hector Martin <marcan@marcan.st>

description: |
  The Apple Interrupt Controller is a simple interrupt controller present on
  Apple ARM SoC platforms, including various iPhone and iPad devices and the
  "Apple Silicon" M1 Macs.

  It provides the following features:

  - Level-triggered hardware IRQs wired to SoC blocks
    - Single mask bit per IRQ
    - Per-IRQ affinity setting
    - Automatic masking on event delivery (auto-ack)
    - Software triggering (ORed with hw line)
  - 2 per-CPU IPIs (meant as "self" and "other", but they are interchangeable
    if not symmetric)
  - Automatic prioritization (single event/ack register per CPU, lower IRQs =
    higher priority)
  - Automatic masking on ack
  - Default "this CPU" register view and explicit per-CPU views

  This driver creates two IRQ domains, one for HW IRQs and the timer FIQs, and
  one for IPIs.

  Since Linux needs more than 2 IPIs, we implement a software IRQ controller
  and funnel all IPIs into one per-CPU IPI (the second "self" IPI is unused).

  - FIQ hwirq numbers are assigned after true hwirqs, and are per-cpu
  - DT bindings use 3-cell form (like GIC):
    - <0 nr flags> - hwirq #nr
    - <1 nr flags> - FIQ #nr
      - nr=0  physical timer
      - nr=1  virtual timer
    - <2 nr flags> - IPI #nr
      - nr=0  other IPI (used internally for the virtual IPIs)
      - nr=1  self IPI (unused)

allOf:
  - $ref: /schemas/interrupt-controller.yaml#

properties:
  compatible:
    contains:
      enum:
        - AAPL,aic
        - AAPL,m1-aic

  interrupt-controller: true

  '#interrupt-cells':
    const: 3
    description: |
      The 1st cell contains the interrupt type:
        - 0: Hardware IRQ
        - 1: FIQ
        - 2: IPI

      The 2nd cell contains the interrupt number.
        - HW IRQs: interrupt number
        - FIQs:
          - 0: physical timer
          - 1: virtual timer
        - IPIs:
          - 0: normal/"other" IPI (used interanlly for virtual IPIs)
          - 1: self IPI (normally unused)

      The 3rd cell contains the interrupt flags. This is normally
      IRQ_TYPE_LEVEL_HIGH (4).

  reg:
    description: |
      Specifies base physical address and size of the AIC registers.
    maxItems: 1

required:
  - compatible
  - '#interrupt-cells'
  - interrupt-controller
  - reg

unevaluatedProperties: false

examples:
  - |
    soc {
        #address-cells = <2>;
        #size-cells = <2>;

        aic: interrupt-controller@23b100000 {
            compatible = "AAPL,m1-aic", "AAPL,aic";
            #interrupt-cells = <3>;
            interrupt-controller;
            reg = <0x2 0x3b100000 0x0 0x8000>;
        };
    };
```
